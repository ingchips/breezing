## boards/arm/ing9168_mini/Kconfig.board
```kconfig
# SPDX-License-Identifier: Apache-2.0

config BOARD_INGCHIPS_ING9168
	bool "ingchips board ing9168 (QEMU)"
	depends on SOC_INGCHIPS_ING9168
	select QEMU_TARGET
```

## boards/arm/ing9168_mini/Kconfig.defconfig
```kconfig
# SPDX-License-Identifier: Apache-2.0

if BOARD_INGCHIPS_ING9168

config BUILD_OUTPUT_BIN
	default n

config BOARD
	default "boards_ingchips_ing9168"

# DWT is not properly emulated in QEMU
choice NULL_POINTER_EXCEPTION_DETECTION
	bool
	default NULL_POINTER_EXCEPTION_DETECTION_NONE
endchoice

endif # BOARD_INGCHIPS_ING9168
```

## boards/arm/ing9168_mini/ing9168_mini_defconfig
```kconfig
# SPDX-License-Identifier: Apache-2.0

CONFIG_SYS_CLOCK_HW_CYCLES_PER_SEC=32768
CONFIG_SOC_INGCHIPS_ING9168=y
CONFIG_BOARD_INGCHIPS_ING9168=y
CONFIG_CONSOLE=y
CONFIG_UART_CONSOLE=y
CONFIG_SERIAL=y
CONFIG_SCHED_MULTIQ=y
CONFIG_QEMU_ICOUNT_SHIFT=6
CONFIG_BUILD_OUTPUT_BIN=y
CONFIG_BUILD_OUTPUT_HEX=y
CONFIG_PRINTK=y
CONFIG_HEAP_MEM_POOL_SIZE=10000
CONFIG_PM=y
CONFIG_GPIO=y
CONFIG_I2C=y
# Enable Timer and Sys clock
CONFIG_SYS_CLOCK_TICKS_PER_SEC=1024
CONFIG_ARM_ARCH_TIMER=y
#CONFIG_ING916_SYSTICK=y
```

## drivers/gpio/Kconfig.ingchips
```kconfig
# INGCHIPS GPIO configuration

# Copyright (c) 2016 Open-RnD Sp. z o.o.
# SPDX-License-Identifier: Apache-2.0
config GPIO_INGCHIPS
	bool "GPIO Driver for ingchips family of MCUs"
	default y
	depends on DT_HAS_INGCHIPS_ING_GPIO_ENABLED
	help
	  Enable GPIO driver for INGCHIPS line of MCUs
```

## drivers/i2c/Kconfig.ingchips
```kconfig
# INGCHIPS I2C configuration

# Copyright (c) 2016 Open-RnD Sp. z o.o.
# SPDX-License-Identifier: Apache-2.0
config I2C_INGCHIPS
	bool "I2C Driver for ingchips family of MCUs"
	default y
	depends on DT_HAS_INGCHIPS_ING_I2C_ENABLED
	help
	  Enable GPIO driver for INGCHIPS line of MCUs
```

## drivers/serial/Kconfig.ingchips
```kconfig
config UART_INGCHIPS
	bool "INGCHIPS UART driver"
	default y
	depends on DT_HAS_INGCHIPS_ING_UART_ENABLED
	select SERIAL_HAS_DRIVER
	select SERIAL_SUPPORT_INTERRUPT
	help
	  This option enables the ingchips serial driver.
```

## drivers/timer/Kconfig.ing916
```kconfig
# Copyright (c) 2014-2015 Wind River Systems, Inc.
# Copyright (c) 2016 Cadence Design Systems, Inc.
# Copyright (c) 2019 Intel Corp.
# SPDX-License-Identifier: Apache-2.0

config ING916_SYSTICK
	bool "ING916 SYSTICK timer"
    depends on TICKLESS_KERNEL
    default y
```

## dts/bindings/flash_controller/ingchips,ing-flash-controller.yaml
```yaml
# Copyright (c) 2020, Linaro Limited
# SPDX-License-Identifier: Apache-2.0

description: ingchips ing flash controller

compatible: "ingchips,ing-flash-controller"

include: flash-controller.yaml
```

## dts/bindings/gpio/ingchips,ing-gpio.yaml
```yaml
# SPDX-License-Identifier: Apache-2.0

description: INGCHIPS ing GPIO node

compatible: "ingchips,ing-gpio"

include: [gpio-controller.yaml, base.yaml]

properties:
  reg:
    required: true

  interrupts:
    required: true

  "#gpio-cells":
    const: 2

gpio-cells:
  - pin
  - flags
```

## dts/bindings/i2c/ingchips,ing-i2c.yaml
```yaml
# Copyright (c) 2021, Ingchips Semiconductor
# SPDX-License-Identifier: Apache-2.0

description: INGCHIPS ING I2C

include: [i2c-controller.yaml, pinctrl-device.yaml]

compatible: "ingchips,ing-i2c"

properties:
  reg:
    required: true

  pinctrl-0:
    required: true
```

## dts/bindings/serial/ingchips,ing-uart.yaml
```yaml
description: INGCHIPS Ing UART

compatible: "ingchips,ing-uart"

include: uart-controller.yaml

properties:
  reg:
    required: true

  interrupts:
    required: true
```

## modules/Kconfig.ingchips
```kconfig
config HAS_INGCHIPS_DRIVERS
	bool "INGCHIPS Drivers"
	help
	  This option enables ingchips Drivers APIs.
```

## soc/arm/ing9168/Kconfig
```kconfig
# Copyright (c) 2014-2015 Wind River Systems, Inc.
# SPDX-License-Identifier: Apache-2.0

config SOC_INGCHIPS_ING9168_QEMU
	def_bool y
	depends on SOC_INGCHIPS_ING9168
	# Platform has only been tested on QEMU, not on real hardware, so always
	# assume it is used for a QEMU target.

config ING916_SYSTICK
	default y

config CORTEX_M_SYSTICK
	bool "disable this."
	default n

config VECTOR_IN_RAM
	bool "is vector in RAM?"
	default y
```

## soc/arm/ing9168/Kconfig.defconfig
```kconfig
# TI LM3S6965 platform configuration options

# Copyright (c) 2014-2015 Wind River Systems, Inc.
# SPDX-License-Identifier: Apache-2.0

if SOC_INGCHIPS_ING9168
config SOC
	default "ing9168"

config ING916_SYSTICK
	default n

config CORTEX_M_SYSTICK
	default y

config NUM_IRQS
	# must be >= the highest interrupt number used
	# - include the UART interrupts and ethernet interrupts
	default 47

config SYS_CLOCK_HW_CYCLES_PER_SEC
	default 12000000

if UART_STELLARIS

config UART_STELLARIS_PORT_0
	default y

config UART_STELLARIS_PORT_1
	default y

config UART_STELLARIS_PORT_2
	default y

endif # UART_STELLARIS

endif
```

## soc/arm/ing9168/Kconfig.soc
```kconfig
# SPDX-License-Identifier: Apache-2.0

config SOC_INGCHIPS_ING9168
	bool "INGCHIPS ING9168"
	# select ING916_SYSTICK
	select ARM
	select CPU_CORTEX_M4
	select CPU_CORTEX_M_HAS_DWT
	select CPU_HAS_FPU
	select CPU_HAS_ARM_MPU
	select HAS_SWO
	select HAS_PM
	select HAS_POWEROFF
	select HAS_INGCHIPS_DRIVERS
	select DYNAMIC_INTERRUPTS
	select VECTOR_IN_RAM
	select THREAD_STACK_INFO
	select DYNAMIC_THREAD
	help
	  Enable support for ING9168
```

## west.yml
```yaml
# The west manifest file for upstream Zephyr.
#
# The per-installation west configuration file, .west/config, sets the
# path to the project containing this file in the [manifest] section's
# "path" variable.
#
# You are free to create your own manifest files and put them in any
# repository you want, to create your own custom Zephyr installations.
# For example, you could create a manifest file in your own out of
# tree application directory, which would pull this zephyr repository
# in as an ordinary project.
#
# You can pass your manifest repositories to west init when creating a
# new Zephyr installation. See the west documentation for more
# information.

manifest:
  defaults:
    remote: upstream

  remotes:
    - name: upstream
      url-base: https://github.com/zephyrproject-rtos

  #
  # Please add items below based on alphabetical order
  projects:
    - name: cmsis
      revision: 4b96cbb174678dcd3ca86e11e1f24bc5f8726da0
      path: modules/hal/cmsis
      groups:
        - hal
    - name: fatfs
      revision: 427159bf95ea49b7680facffaa29ad506b42709b
      path: modules/fs/fatfs
      groups:
        - fs
    - name: littlefs
      path: modules/fs/littlefs
      groups:
        - fs
      revision: ca583fd297ceb48bced3c2548600dc615d67af24
    - name: mipi-sys-t
      path: modules/debug/mipi-sys-t
      groups:
        - debug
      revision: a819419603a2dfcb47f7f39092e1bc112e45d1ef
    - name: percepio
      path: modules/debug/percepio
      revision: 0fbc5b72aeab8a6434523a3a7bc8111c17f0bc73
      groups:
        - debug
    - name: segger
      revision: 9d0191285956cef43daf411edc2f1a7788346def
      path: modules/debug/segger
      groups:
        - debug
    - name: tinycrypt
      revision: 3e9a49d2672ec01435ffbf0d788db6d95ef28de0
      path: modules/crypto/tinycrypt
      groups:
        - crypto

  self:
    path: zephyr
    west-commands: scripts/west-commands.yml
    import: submanifests
```
