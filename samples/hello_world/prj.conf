## CMakeLists.txt
```
# SPDX-License-Identifier: Apache-2.0

cmake_minimum_required(VERSION 3.20.0)

find_package(Zephyr REQUIRED HINTS $ENV{ZEPHYR_BASE})
project(hello_world)

target_sources(app PRIVATE src/main.c)
target_link_options(app PUBLIC -Wl,--just-symbols=${ZEPHYR_BASE}/../modules/hal/ingchips/bundles/noos_mini/ING9168xx/symdefs.g)
```

## prj.conf
```kconfig
# nothing here
CONFIG_HEAP_MEM_POOL_SIZE=10000
```

## src/main.c
```c
/*
 * Copyright (c) 2012-2014 Wind River Systems, Inc.
 *
 * SPDX-License-Identifier: Apache-2.0
 */

#include <stdio.h>
#include <zephyr/kernel.h>
int main(void)
{
	printf("Hello World! %s\n", CONFIG_BOARD);
	while(1) {
		printf("hello\r\n");
		k_sleep(K_MSEC(10000));
	}
	return 0;
}
```
